## buildroot/package/configtxt/Config.in
```kconfig
config BR2_PACKAGE_CONFIGTXT
	bool "configtxt"
	help
	  Configure Raspberry Pi boot settings: I2C, SPI, audio overlays.
	depends on BR2_PACKAGE_RPI_FIRMWARE

config BR2_PACKAGE_CONFIGTXT_QUIET
	bool "quiet boot mode"
	help
	  Disable all boot messages to screen.
	depends on BR2_PACKAGE_CONFIGTXT

config BR2_PACKAGE_CONFIGTXT_EEPROM
	bool "force_eeprom_read workaround"
	help
	  Set force_eeprom_read=0 for boards without HAT EEPROM.
	depends on BR2_PACKAGE_CONFIGTXT

config BR2_PACKAGE_CONFIGTXT_DAC_OVERLAY
	string "I2S DAC/AMP device tree overlay"
	default ""
	help
	  Device tree overlay for your I2S DAC/AMP board.
	  Leave empty for HAT EEPROM auto-detection.
	  Common overlays:
	    snapdog-dacplus, snapdog-dacplusadc, snapdog-dac,
	    snapdog-amp, snapdog-amp3,
	    allo-boss-dac-pcm512x-audio, allo-digione,
	    iqaudio-dacplus, iqaudio-dac,
	    justboom-dac, justboom-digi,
	    googlevoicehat-soundcard,
	    fe-pi-audio, i-sabre-q2m,
	    max98357a, adau7002-simple
	depends on BR2_PACKAGE_CONFIGTXT
```

## buildroot/package/copy-overlays/Config.in
```kconfig
config BR2_PACKAGE_COPY_OVERLAYS
	bool "copy overlays"
	help
	  Copy device tree overlays (I2S DAC/AMP boards) to firmware directory.
```

## buildroot/package/snapdog-base/Config.in
```kconfig
config BR2_PACKAGE_SNAPDOG_BASE
	bool "snapdog-base"
	help
	  Base prerequisites for SnapDog OS.
	select BR2_PACKAGE_ALSA_LIB
	select BR2_PACKAGE_ALSA_UTILS
	select BR2_PACKAGE_ALSA_UTILS_ALSACTL
	select BR2_PACKAGE_ALSA_UTILS_APLAY
	select BR2_USE_MMU
```

## buildroot/package/snapdog-ctrl/Config.in
```kconfig
config BR2_PACKAGE_SNAPDOG_CTRL
	bool "snapdog-ctrl"
	help
	  Web-based device setup for SnapDog OS.
	  Provides WiFi configuration, network settings,
	  and snapdog-client configuration via a local web UI.
	  https://github.com/metaneutrons/snapdog-ctrl
```

## buildroot/package/snapdog-tools/Config.in
```kconfig
config BR2_PACKAGE_SNAPDOG_TOOLS
	bool "snapdog-tools"
	help
	  Boot-time system tools for SnapDog OS.
	depends on BR2_PACKAGE_SNAPDOG_BASE
	select BR2_PACKAGE_RNG_TOOLS
```

## buildroot/package/snapdog-users/Config.in
```kconfig
config BR2_PACKAGE_SNAPDOG_USERS
	bool "snapdog-users"
	help
	  Creates users and groups required by SnapDog OS.
	depends on BR2_PACKAGE_SNAPDOG_BASE
```
